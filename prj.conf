## CMakeLists.txt
```
# SPDX-License-Identifier: Apache-2.0

cmake_minimum_required(VERSION 3.20.0)
find_package(Zephyr REQUIRED HINTS $ENV{ZEPHYR_BASE})

project(bt-central-cned)

file(GLOB SRC_FILES "src/*.c")


target_sources(app PRIVATE ${SRC_FILES})

target_include_directories(app PRIVATE include)
```

## prj.conf
```kconfig
CONFIG_MAIN_STACK_SIZE=4096
CONFIG_HEAP_MEM_POOL_SIZE=2048

CONFIG_BT=y
CONFIG_BT_CENTRAL=y

CONFIG_LOG=y
CONFIG_LOG_MODE_DEFERRED=y

# 0 = none, 1 = error, 2 = warning, 3 = info, 4 = debug
CONFIG_LOG_DEFAULT_LEVEL=0  
CONFIG_I2C=y
CONFIG_SENSOR=y

# Networking config
CONFIG_NETWORKING=y 
CONFIG_NET_IPV4=y
CONFIG_NET_TCP=y
CONFIG_NET_SOCKETS=y
CONFIG_WIFI=y
CONFIG_POSIX_API=y
CONFIG_TEST_RANDOM_GENERATOR=y

# Network address config
CONFIG_NET_DHCPV4=y
CONFIG_NET_CONFIG_AUTO_INIT=n

# Network debug config
CONFIG_LOG=y
CONFIG_NET_LOG=y
CONFIG_WIFI_LOG_LEVEL_ERR=y
CONFIG_LOG_BUFFER_SIZE=8192


CONFIG_NET_MGMT=y
CONFIG_NET_MGMT_EVENT=y

CONFIG_NET_L2_WIFI_MGMT=y

CONFIG_NET_CONTEXT_NET_PKT_POOL=y
CONFIG_NET_PKT_RX_COUNT=12
CONFIG_NET_PKT_TX_COUNT=12
CONFIG_NET_BUF_RX_COUNT=32
CONFIG_NET_BUF_TX_COUNT=32
```

## src/main.c
```c
/* main.c - Application main entry point */

#include <zephyr/kernel.h>
#include <zephyr/sys/printk.h>
#include "scan_bt.h"
#include "auth_controller.h"
#include "led_feedback.h"
#include "wifi.h"
#include "http_client.h"
#include <zephyr/logging/log.h>
#include "auth_worker.h"

LOG_MODULE_REGISTER(main, LOG_LEVEL_INF);

int main(void)
{
    struct auth_result_msg msg;
    LOG_INF("BT - Central - Contrôle d'accès Module Integration\n");

    if (wifi_connect() != 0)
    {
        LOG_INF("Erreur Wi-Fi, arrêt.\n");
        return -1;
    }

    led_feedback_init();
    auth_controller_init();
    auth_worker_init();
    bt_scan_thread_start();

    while (1)
    {
        LOG_INF("Alive !");
        k_sleep(K_MSEC(2000));
    }

    return 0;
}
```

## include/auth_controller.h
```c
#ifndef AUTH_CONTROLLER_H
#define AUTH_CONTROLLER_H

#include <stdint.h>
#include <stdbool.h>
#include <zephyr/kernel.h>

struct auth_result_msg {
    uint32_t badge_id;
    bool access_granted;
};

void auth_controller_init(void);
bool auth_handle_badge_id(uint32_t badge_id);
struct k_msgq *auth_get_msgq(void);

#endif // AUTH_CONTROLLER_H
```

## include/auth_worker.h
```c
#ifndef AUTH_WORKER_H
#define AUTH_WORKER_H

#include <stdint.h>

void auth_worker_init(void);
void auth_worker_submit(uint32_t badge_id);

#endif // AUTH_WORKER_H
```

## include/http_client.h
```c
#ifndef HTTP_CLIENT_H
#define HTTP_CLIENT_H

#include <stdbool.h>
#include <stdint.h>

bool http_query_badge(uint32_t badge_id);

#endif // HTTP_CLIENT_H
```

## include/led_feedback.h
```c
#ifndef LED_FEEDBACK_H
#define LED_FEEDBACK_H

void led_feedback_init(void); 

void led_show_access_ok(void);

void led_show_access_denied(void);

void led_show_access_off(void);

#endif
```

## include/radio_mutex.h
```c
#ifndef RADIO_MUTEX_H
#define RADIO_MUTEX_H

#include <zephyr/kernel.h>

extern struct k_mutex radio_mutex;

#endif // RADIO_MUTEX_H
```

## include/scan_bt.h
```c
// scan_bt.h
#ifndef SCAN_BT_H
#define SCAN_BT_H

#include <zephyr/types.h>
#include <zephyr/bluetooth/bluetooth.h>
#include <zephyr/bluetooth/hci.h>
#include <zephyr/bluetooth/conn.h>

#define RSSI_THRESHOLD -50
#define BADGE_ID_AUTORISE 0x01020304

void bt_scan_thread_start(void); 

#endif // SCAN_BT_H
```

## include/wifi.h
```c
#ifndef WIFI_H
#define WIFI_H


int wifi_connect(void);
#endif
```

## src/auth_controller.c
```c
#include "auth_controller.h"
#include <zephyr/logging/log.h>
#include <zephyr/kernel.h>
#include "http_client.h"

LOG_MODULE_REGISTER(auth_controller, LOG_LEVEL_INF);

K_MSGQ_DEFINE(auth_msgq, sizeof(struct auth_result_msg), 10, 4);

void auth_controller_init(void) {}

bool auth_handle_badge_id(uint32_t badge_id)
{
    LOG_INF("debut auth_handle_badge_id");
    static int64_t last_auth_time = 0;
    static uint32_t last_badge_id = 0;
    const int64_t now = k_uptime_get();
    const int64_t AUTH_DEBOUNCE_MS = 5000;

    if (badge_id == last_badge_id && (now - last_auth_time < AUTH_DEBOUNCE_MS))
    {
        LOG_INF("Badge ignoré (déjà vu récemment): 0x%08X", badge_id);
        return false;
    }

    last_auth_time = now;
    last_badge_id = badge_id;

    // HYPER IMPORTANT POUR PAS QUE CA PLANTE !!!!
    k_msleep(100); // petite pause pour désamorcer radio

    bool granted = http_query_badge(badge_id);

    struct auth_result_msg msg = {
        .badge_id = badge_id,
        .access_granted = granted,
    };

    if (k_msgq_put(&auth_msgq, &msg, K_NO_WAIT) != 0)
    {
        LOG_WRN("auth msgq full, dropping badge_id 0x%08X", badge_id);
    }

    if (granted)
    {
        LOG_INF("Badge autorisé  (ID = 0x%08X)", badge_id);
    }
    else
    {
        LOG_INF("Badge refusé  (ID = 0x%08X)", badge_id);
    }
    LOG_INF("fin auth_handle_badge_id");

    return granted;
}

struct k_msgq *auth_get_msgq(void)
{
    return &auth_msgq;
}
```

## src/auth_worker.c
```c
#include <zephyr/kernel.h>
#include <zephyr/logging/log.h>
#include "auth_controller.h"

LOG_MODULE_REGISTER(auth_worker, LOG_LEVEL_INF);

#define QUEUE_SIZE 5
K_MSGQ_DEFINE(badge_queue, sizeof(uint32_t), QUEUE_SIZE, 4);

#define STACK_SIZE 1024
#define PRIORITY 5
K_THREAD_STACK_DEFINE(worker_stack, STACK_SIZE);
static struct k_thread worker_thread;

static void auth_worker_thread(void *a, void *b, void *c)
{
    uint32_t badge_id;

    while (1)
    {
        if (k_msgq_get(&badge_queue, &badge_id, K_FOREVER) == 0)
        {
            LOG_INF("Traitement déporté du badge 0x%08X", badge_id);
            auth_handle_badge_id(badge_id);
        }
    }
}

void auth_worker_init(void)
{
    k_thread_create(&worker_thread, worker_stack, STACK_SIZE,
                    auth_worker_thread, NULL, NULL, NULL,
                    PRIORITY, 0, K_NO_WAIT);
}

void auth_worker_submit(uint32_t badge_id)
{
    if (k_msgq_put(&badge_queue, &badge_id, K_NO_WAIT) != 0)
    {
        LOG_WRN("Queue saturée, badge ignoré: 0x%08X", badge_id);
    }
}
```

## src/http_client.c
```c
#include <stdio.h>
#include <stdlib.h>
#include <string.h>
#include <zephyr/kernel.h>
#include <zephyr/net/socket.h>

#include "http_client.h"

#define HTTP_HOST "ADR IP DU SRV FLASK"
#define HTTP_PORT "5000"
#define HTTP_PATH "/check_badge"

#define DEVICE_ID "disco-zephyr"
#define ZONE "zone-admin"

#define PAYLOAD_BUFFER_SIZE 512
#define REQUEST_BUFFER_SIZE 512
#define RESPONSE_BUFFER_SIZE 512

static char payload[PAYLOAD_BUFFER_SIZE];
static char request[REQUEST_BUFFER_SIZE];
static char response[RESPONSE_BUFFER_SIZE];

LOG_MODULE_REGISTER(http_client, LOG_LEVEL_INF);

static int connect_http_server(const char *host, const char *port)
{
    struct addrinfo hints = {0}, *res;
    int sock, ret;

    hints.ai_family = AF_INET;
    hints.ai_socktype = SOCK_STREAM;

    ret = getaddrinfo(host, port, &hints, &res);
    if (ret != 0)
    {
        LOG_INF("getaddrinfo() failed: %d\n", ret);
        return -1;
    }

    sock = socket(res->ai_family, res->ai_socktype, res->ai_protocol);
    if (sock < 0)
    {
        LOG_INF("socket() failed\n");
        freeaddrinfo(res);
        return -1;
    }

    ret = connect(sock, res->ai_addr, res->ai_addrlen);
    freeaddrinfo(res);
    if (ret < 0)
    {
        LOG_INF("connect() failed\n");
        close(sock);
        return -1;
    }

    return sock;
}

bool http_query_badge(uint32_t badge_id)
{
    int ret, total = 0;
    LOG_INF("debut http_query_badge");

    snprintf(payload, sizeof(payload),
         "{\"badgeNumber\":\"%08X\","
         "\"device_id\":\"%s\","
         "\"zone\":\"%s\"}",
         badge_id, DEVICE_ID, ZONE);

    int len = snprintf(request, sizeof(request),
                       "POST " HTTP_PATH " HTTP/1.1\r\n"
                       "Host: " HTTP_HOST "\r\n"
                       "Content-Type: application/json\r\n"
                       "Content-Length: %zu\r\n"
                       "Connection: close\r\n"
                       "\r\n"
                       "%s",
                       strlen(payload), payload);

    if (len >= sizeof(request))
    {
        LOG_WRN("Request too large!");
        return false;
    }

    int sock = connect_http_server(HTTP_HOST, HTTP_PORT);
    if (sock < 0)
    {
        return false;
    }

    ret = send(sock, request, len, 0);
    if (ret <= 0)
    {
        LOG_WRN("send() failed");
        close(sock);
        return false;
    }

    k_msleep(200); // Laisse le temps à es-WiFi

    int64_t t_start = k_uptime_get();
    const int64_t timeout_ms = 3000;

    while (total < sizeof(response) - 1)
    {
        if (k_uptime_get() - t_start > timeout_ms)
        {
            LOG_WRN("HTTP timeout atteint, sortie de boucle recv()");
            break;
        }

        ret = recv(sock, response + total, sizeof(response) - 1 - total, MSG_DONTWAIT);

        if (ret == 0)
            break;
        if (ret < 0)
        {
            k_msleep(100);
            continue;
        }
        total += ret;
    }

    shutdown(sock, SHUT_RDWR);
    k_msleep(100);
    close(sock);
    k_msleep(500); // stable pour eswifi

    k_sleep(K_SECONDS(2));
    response[total] = '\0';

    // LOG_INF("Response:\n%s", response);
    LOG_INF("fin http_query_badge");
    if (strstr(response, "\"access\":true"))
    {
        return true;
    }

    return false;
}
```

## src/led_feedback.c
```c
// led_feedback.c
#include "led_feedback.h"
#include <zephyr/device.h>
#include <zephyr/drivers/gpio.h>
#include <zephyr/logging/log.h>

LOG_MODULE_REGISTER(led_feedback, LOG_LEVEL_INF);

#define LED_OK_NODE DT_ALIAS(led0)
#define LED_KO_NODE DT_ALIAS(led1)

static const struct gpio_dt_spec led_ok = GPIO_DT_SPEC_GET(LED_OK_NODE, gpios);
static const struct gpio_dt_spec led_ko = GPIO_DT_SPEC_GET(LED_KO_NODE, gpios);

void led_feedback_init(void)
{
    if (!device_is_ready(led_ok.port) || !device_is_ready(led_ko.port))
    {
        LOG_ERR("LED devices not ready");
        return;
    }

    gpio_pin_configure_dt(&led_ok, GPIO_OUTPUT_INACTIVE);
    gpio_pin_configure_dt(&led_ko, GPIO_OUTPUT_INACTIVE);
}

void led_show_access_ok(void)
{
    gpio_pin_set_dt(&led_ok, 1);
    gpio_pin_set_dt(&led_ko, 0);
}

void led_show_access_denied(void)
{
    gpio_pin_set_dt(&led_ok, 0);
    gpio_pin_set_dt(&led_ko, 1);
}

void led_show_access_off(void)
{
    gpio_pin_set_dt(&led_ok, 0);
    gpio_pin_set_dt(&led_ko, 0);
}
```

## src/radio_mutex.c
```c
#include "radio_mutex.h"

struct k_mutex radio_mutex;
```
